## conf/layer.conf
```bitbake
# Layer configuration for meta-bootgen
LAYERVERSION = "1"

# We have a conf and classes directory, add to BBPATH
BBPATH .= ":${LAYERDIR}"

# We have recipes-* directories, add to BBFILES
BBFILES += "${LAYERDIR}/recipes-*/*/*.bb \
            ${LAYERDIR}/recipes-*/*/*.bbappend"

# Layer priority
BBFILE_PRIORITY_meta-bootgen = "6"

# Additional paths
BBFILE_COLLECTIONS += "meta-bootgen"
BBFILE_PATTERN_meta-bootgen = "^${LAYERDIR}/"

LAYERDEPENDS_meta-bootgen = "core"

# Licensing
LAYERSERIES_COMPAT_meta-bootgen = "kirkstone"
```
